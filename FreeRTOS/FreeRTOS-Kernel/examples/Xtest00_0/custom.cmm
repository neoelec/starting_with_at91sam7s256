// SPDX-License-Identifier: GPL-2.0+
// Copyright (c) 2025 YOUNGJIN JOO (neoelec@gmail.com)

B::
ON ERROR DO &G_RCN_Path/error.cmm

PRIVATE &E_Func &E_Args
ENTRY &E_Func %LINE &E_Args
PRIVATE &ret

GOSUB &E_Func &E_Args
ENTRY %LINE &ret

ENDDO &ret

on_running:
(
  GOSUB __freertos_awareness
  Go.direct

  END // NOTE: not ENDDO when cmm is called by a break point
)

on_booting:
(
  GOSUB __freertos_awareness
  Go.direct

  END // NOTE: not ENDDO when cmm is called by a break point
)

__freertos_awareness:
(
  ; load FreeRTOS kernel awareness
  TASK.CONFIG ~~/demo/arm/kernel/freertos/freertos.t32
  MENU.ReProgram ~~/demo/arm/kernel/freertos/freertos.men

  RETURN
)
